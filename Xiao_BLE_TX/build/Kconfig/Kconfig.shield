## Xiao_BLE_TX/build/Kconfig/boards/Kconfig.defconfig
```kconfig
# Load Zephyr board defconfig descriptions.
osource "/home/dayang/csse4011/zephyr/boards/seeed/xiao_ble/Kconfig.defconfig"
```

## Xiao_BLE_TX/build/Kconfig/boards/Kconfig.sysbuild
```kconfig
# Load Sysbuild board Kconfig descriptions.
osource "/home/dayang/csse4011/zephyr/boards/seeed/xiao_ble/Kconfig.sysbuild"
```

## finalproject/build/Kconfig/Kconfig.shield
```kconfig
osource "/Users/sunruimandepc/csse4011/firmware/boards/shields/*/Kconfig.shield"
```

## finalproject/build/Kconfig/arch/Kconfig
```kconfig
# Load Zephyr Arch Kconfig descriptions.
osource "/Users/sunruimandepc/csse4011/zephyr/arch/rx/Kconfig"
osource "/Users/sunruimandepc/csse4011/zephyr/arch/x86/Kconfig"
osource "/Users/sunruimandepc/csse4011/zephyr/arch/xtensa/Kconfig"
osource "/Users/sunruimandepc/csse4011/zephyr/arch/sparc/Kconfig"
osource "/Users/sunruimandepc/csse4011/zephyr/arch/riscv/Kconfig"
osource "/Users/sunruimandepc/csse4011/zephyr/arch/posix/Kconfig"
osource "/Users/sunruimandepc/csse4011/zephyr/arch/mips/Kconfig"
osource "/Users/sunruimandepc/csse4011/zephyr/arch/arm64/Kconfig"
osource "/Users/sunruimandepc/csse4011/zephyr/arch/arm/Kconfig"
osource "/Users/sunruimandepc/csse4011/zephyr/arch/arc/Kconfig"
```

## finalproject/build/Kconfig/boards/Kconfig
```kconfig
# Load Zephyr board Kconfig descriptions.
osource "/Users/sunruimandepc/csse4011/zephyr/boards/seeed/xiao_ble/Kconfig"
```

## finalproject/build/Kconfig/boards/Kconfig.defconfig
```kconfig
# Load Zephyr board defconfig descriptions.
osource "/Users/sunruimandepc/csse4011/zephyr/boards/seeed/xiao_ble/Kconfig.defconfig"
```

## finalproject/build/Kconfig/boards/Kconfig.xiao_ble
```kconfig
# Load board Kconfig descriptions.
osource "/Users/sunruimandepc/csse4011/zephyr/boards/seeed/xiao_ble/Kconfig.xiao_ble"
```

## xiao_ble_tx/build/Kconfig/arch/Kconfig
```kconfig
# Load Zephyr Arch Kconfig descriptions.
osource "/home/dayang/csse4011/zephyr/arch/rx/Kconfig"
osource "/home/dayang/csse4011/zephyr/arch/x86/Kconfig"
osource "/home/dayang/csse4011/zephyr/arch/xtensa/Kconfig"
osource "/home/dayang/csse4011/zephyr/arch/sparc/Kconfig"
osource "/home/dayang/csse4011/zephyr/arch/riscv/Kconfig"
osource "/home/dayang/csse4011/zephyr/arch/posix/Kconfig"
osource "/home/dayang/csse4011/zephyr/arch/mips/Kconfig"
osource "/home/dayang/csse4011/zephyr/arch/arm64/Kconfig"
osource "/home/dayang/csse4011/zephyr/arch/arm/Kconfig"
osource "/home/dayang/csse4011/zephyr/arch/arc/Kconfig"
```

## xiao_ble_tx/build/Kconfig/boards/Kconfig
```kconfig
# Load Zephyr board Kconfig descriptions.
osource "/home/dayang/csse4011/zephyr/boards/seeed/xiao_ble/Kconfig"
```

## xiao_ble_tx/build/Kconfig/boards/Kconfig.xiao_ble
```kconfig
# Load board Kconfig descriptions.
osource "/home/dayang/csse4011/zephyr/boards/seeed/xiao_ble/Kconfig.xiao_ble"
```
